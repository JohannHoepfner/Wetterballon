## firmware/components/intercom/radio/Kconfig
```kconfig
menu "Radio config"
    config RADIO_AMP_PWK
        int "Pin of the Power Key for Amplifier"
        default 15
    config RADIO_SDA_PIN
        int "Pin of the si5351 for sda"
        default 6
    config RADIO_SCL_PIN
        int "Pin of the si5351 for sda"
        default 7
    config RADIO_FREQ_BASE
        int "Base frequency for sending"
        default 28099870
    config RADIO_FREQ_SHIFT
        int "Shift frequency for sending"
        default 170
    config RADIO_BIT_US
        int "Microseconds per RTTY bit"
        default 22002
    config RADIO_STOP_BITS
        int "Number of RTTY stop bits"
        default 2
endmenu
```

## firmware/components/intercom/sim_modem/Kconfig
```kconfig
menu "Sim7600 modem config"
    config MODEM_UART_TX_PIN
        int "Modem UART TXD pin"
        default 20

    config MODEM_UART_RX_PIN
        int "Modem UART RXD pin"
        default 21

    config MODEM_UART_RTS_PIN
        int "Modem UART RTS pin"
        default 22

    config MODEM_UART_CTS_PIN
        int "Modem UART CTS pin"
        default 23

    config MODEM_PPP_APN
        string "Cellular APN"
        default "internet"

    config MODEM_NEED_SIM_PIN
        bool "SIM PIN needed"
        default n

    config MODEM_SIM_PIN
        string "SIM PIN"
        default "1234"
        depends on MODEM_NEED_SIM_PIN

    config MODEM_SMTP_HOST
        string "SMTP server hostname/IP"
        default "mail.johann-hoepfner.de"
        help
            Mail server contacted directly (no relay auth, no MX lookup).

    config MODEM_SMTP_PORT
        int "SMTP server port"
        default 25

    config MODEM_MAIL_FROM
        string "Envelope/header From address"
        default "wb@wb"

    config MODEM_MAIL_TO
        string "Envelope/header To address"
        default "wb@johann-hoepfner.de"

    config MODEM_SEND_INTERVAL_SEC
        int "Email send interval in seconds"
        default 3600
        range 1 2147483
endmenu
```

## firmware/components/sensor/bme280_s/Kconfig
```kconfig
menu "BME280"
    config BME280_SDA_PIN
        int "BME280 SDA pin number"
        default 11
        range 0 56

    config BME280_SCL_PIN
        int "BME280 SCL pin number"
        default 10
        range 0 56
endmenu
```

## firmware/components/sensor/pt1000/Kconfig
```kconfig
menu "PT1000"
    menu "I2C Configuration"
        config PT1000_I2C_SDA_PIN
            int "SDA Pin Number"
            default 6
            range 0 56
        config PT1000_I2C_SCL_PIN
            int "SCL Pin Number"
            default 7
            range 0 56
        config PT1000_I2C_ADC_ADDR
            hex "I2C Address of ads1115"
            default 0x49
            range 0x48 0x4b
    endmenu
endmenu
```

## firmware/components/store/sd_card/Kconfig
```kconfig
menu "SD_CARD"
    config SD_CARD_MOUNT_POINT
        string "SD card mount point"
        default "/sdcard"
endmenu
```

## firmware/nodes/sens_misc/sdkconfig.defaults
```kconfig
CONFIG_IDF_TARGET="esp32c6"
CONFIG_ESPTOOLPY_FLASHSIZE_4MB=y
CONFIG_PARTITION_TABLE_SINGLE_APP_LARGE=y

CONFIG_SD_CARD_PIN_MOSI=5
CONFIG_SD_CARD_PIN_MISO=4
CONFIG_SD_CARD_PIN_CLK=10
CONFIG_SD_CARD_PIN_CS=11

CONFIG_LWIP_TCPIP_TASK_STACK_SIZE=4096
CONFIG_LWIP_PPP_SUPPORT=y
CONFIG_LWIP_PPP_ENABLE_IPV6=n
CONFIG_LWIP_PPP_NOTIFY_PHASE_SUPPORT=y
CONFIG_LWIP_PPP_PAP_SUPPORT=y
```

## firmware/nodes/sens_mock/sdkconfig.defaults
```kconfig
CONFIG_IDF_TARGET="esp32c6"
CONFIG_ESPTOOLPY_FLASHSIZE_4MB=y
CONFIG_PARTITION_TABLE_SINGLE_APP_LARGE=y

CONFIG_LWIP_TCPIP_TASK_STACK_SIZE=4096
CONFIG_LWIP_PPP_SUPPORT=y
CONFIG_LWIP_PPP_ENABLE_IPV6=n
CONFIG_LWIP_PPP_NOTIFY_PHASE_SUPPORT=y
CONFIG_LWIP_PPP_PAP_SUPPORT=y
```

## flight-hardware/components/databus/Kconfig
```kconfig
menu "DATABUS"
    config DATABUS_WIFI_CHANNEL
        int "Wifi channel"
        default 1
        help
            WIFI channel to use for databus

    config DATABUS_MESSAGE_PREFIX
        string "ESPNOW message prefix for databus"
        default "WB2025"
        help
            Prefix before every espnow message from and to databus
endmenu
```

## flight-hardware/components/geiger/Kconfig
```kconfig
menu "GEIGER"
    config GEIGER_PULSE_PIN
        int "Geiger counter pulse pin number"
        default 15
        range 0 56
endmenu
```

## flight-hardware/components/intercom/radio/Kconfig
```kconfig
menu "Sim7600 modem config"
    config RADIO_AMP_PWK
        int "Pin of the Power Key for Amplifier"
        default 15
    config RADIO_SDA_PIN
        int "Pin of the si5351 for sda"
        default 6
    config RADIO_SCL_PIN
        int "Pin of the si5351 for sda"
        default 7
    config RADIO_FREQ_BASE
        int "Base frequency for sending"
        default 28090000
    config RADIO_FREQ_SHIFT
        int "Shift frequency for sending"
        default 170
endmenu
```

## flight-hardware/components/sd_card/Kconfig
```kconfig
menu "SD_CARD"
    config SD_CARD_MOUNT_POINT
        string "SD card mount point"
        default "/sdcard"

    config SD_CARD_PIN_MOSI
        int "MOSI GPIO number"
        default 15 if IDF_TARGET_ESP32
        default 35 if IDF_TARGET_ESP32S2
        default 4 if IDF_TARGET_ESP32S3
        default 5  if IDF_TARGET_ESP32H2
        default 36 if IDF_TARGET_ESP32P4
        default 4  # C3 and others

    config SD_CARD_PIN_MISO
        int "MISO GPIO number"
        default 2 if IDF_TARGET_ESP32
        default 37 if IDF_TARGET_ESP32S2
        default 5 if IDF_TARGET_ESP32S3
        default 0  if IDF_TARGET_ESP32H2
        default 47 if IDF_TARGET_ESP32P4
        default 6  # C3 and others

    config SD_CARD_PIN_CLK
        int "CLK GPIO number"
        default 14 if IDF_TARGET_ESP32
        default 36 if IDF_TARGET_ESP32S2
        default 2 if IDF_TARGET_ESP32S3
        default 4  if IDF_TARGET_ESP32H2
        default 53 if IDF_TARGET_ESP32P4
        default 5  # C3 and others

    config SD_CARD_PIN_CS
        int "CS GPIO number"
        default 13 if IDF_TARGET_ESP32
        default 34 if IDF_TARGET_ESP32S2
        default 8 if IDF_TARGET_ESP32S3
        default 1  # C3 and others
endmenu
```

## flight-hardware/components/store/sd_card/Kconfig
```kconfig
menu "SD_CARD"
    config SD_CARD_MOUNT_POINT
        string "SD card mount point"
        default "/sdcard"

    config SD_CARD_PIN_MOSI
        int "MOSI GPIO number"
        default 5

    config SD_CARD_PIN_MISO
        int "MISO GPIO number"
        default 4

    config SD_CARD_PIN_CLK
        int "CLK GPIO number"
        default 6

    config SD_CARD_PIN_CS
        int "CS GPIO number"
        default 0
endmenu
```

## flight-hardware/components/uv_pt100/Kconfig
```kconfig
menu "UV sensor / pt100 board config"
    menu "I2C Configuration"
        config UV_PT100_I2C_SDA_PIN
            int "SDA Pin Number"
            default 6
            range 0 56
        config UV_PT100_I2C_SCL_PIN
            int "SCL Pin Number"
            default 7
            range 0 56
        config UV_PT100_I2C_ADC_1_ADDR
            hex "I2C Address of first ads1115"
            default 0x48
            range 0x48 0x4b
        config UV_PT100_I2C_ADC_2_ADDR
            hex "I2C Address of second ads1115"
            default 0x49
            range 0x48 0x4b
    endmenu
endmenu
```

## flight-hardware/nodes/cell_gateway/sdkconfig.defaults
```kconfig
CONFIG_IDF_TARGET="esp32c6"
CONFIG_PARTITION_TABLE_SINGLE_APP_LARGE=y

CONFIG_LWIP_PPP_SUPPORT=y
CONFIG_LWIP_PPP_PAP_SUPPORT=y
CONFIG_LWIP_PPP_CHAP_SUPPORT=y
```

## flight-hardware/wwan_gateway/sdkconfig.defaults
```kconfig
CONFIG_IDF_TARGET="esp32c6"
CONFIG_ESPTOOLPY_FLASHSIZE_4MB=y
CONFIG_PARTITION_TABLE_SINGLE_APP_LARGE=y

CONFIG_WWAN_GATEWAY_NOTIFICATION_SMS_RECEIPIENT=""

CONFIG_WWAN_GATEWAY_SERVER_HOST=""
CONFIG_WWAN_GATEWAY_SERVER_HTTP_PORT=80
CONFIG_WWAN_GATEWAY_SERVER_HTTP_USERNAME=""
CONFIG_WWAN_GATEWAY_SERVER_HTTP_PASSWORD=""

CONFIG_WWAN_GATEWAY_MODEM_PWK_PIN=11
CONFIG_WWAN_GATEWAY_MODEM_UART_TX_PIN=20
CONFIG_WWAN_GATEWAY_MODEM_UART_RX_PIN=21
CONFIG_WWAN_GATEWAY_MODEM_UART_CTS_PIN=22
CONFIG_WWAN_GATEWAY_MODEM_UART_RTS_PIN=23

CONFIG_LWIP_TCPIP_TASK_STACK_SIZE=4096
CONFIG_LWIP_PPP_SUPPORT=y
CONFIG_LWIP_PPP_ENABLE_IPV6=n
CONFIG_LWIP_PPP_NOTIFY_PHASE_SUPPORT=y
CONFIG_LWIP_PPP_PAP_SUPPORT=y
```
